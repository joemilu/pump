; *************************************************************
; *** Scatter-Loading Description File generated by uVision ***
; ***			Run program in SDRAM	           		    ***
; *************************************************************

LR_ROM1 0x30000000   {    ; load region size_region
  ER_ROM1 0x30000000 0x4000000  {  ;32MB load address = execution address
   *.o (Init, +First)
;   *(InRoot$$Sections)
   .ANY (+RO +RW +ZI)
  }
;    RW_RAM1 0x31000000 0x3000000  {  ;32MB RW data
;   .ANY (+RW +ZI)
;  }
}

